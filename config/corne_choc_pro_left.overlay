/* No encoders on the left half. */

&left_ex1_encoder {
    status = "disabled";
};

&left_ex2_encoder {
    status = "disabled";
};

&right_ex1_encoder {
    status = "disabled";
};

&right_ex2_encoder {
    status = "disabled";
};
